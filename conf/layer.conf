## conf/layer.conf
```bitbake
# We have a conf and classes directory, add to BBPATH
BBPATH .= ":${LAYERDIR}"

# We have recipes-* directories, add to BBFILES
BBFILES += "${LAYERDIR}/recipes-*/*/*.bb \
            ${LAYERDIR}/recipes-*/*/*.bbappend"

BBFILE_COLLECTIONS += "meta-seeed-voicecard"
BBFILE_PATTERN_meta-seeed-voicecard = "^${LAYERDIR}/"
BBFILE_PRIORITY_meta-seeed-voicecard = "6"

LAYERDEPENDS_meta-seeed-voicecard = "core"
LAYERSERIES_COMPAT_meta-seeed-voicecard = "kirkstone"
```
